## isarpm/conf/layer.conf
```bitbake
# We have a conf and classes directory, add to BBPATH
BBPATH =. "${LAYERDIR}:"

# We have recipes-* directories, add to BBFILES
BBFILES += "${LAYERDIR}/recipes-*/*/*.bb"

BBFILE_COLLECTIONS += "isarpm"
BBFILE_PATTERN_isarpm = "^${LAYERDIR}/"
BBFILE_PRIORITY_isarpm = "5"

LAYERSERIES_CORENAMES = "proto"

# This should only be incremented on significant changes that will
# cause compatibility issues with other layers
LAYERVERSION_isarpm = "1"
LAYERSERIES_COMPAT_isarpm = "proto"

# Set a variable to get to the top of the metadata location
COREBASE = '${@os.path.normpath("${LAYERDIR}/../")}'

# We need to keep bitbake tools in PATH
# Avoid empty path entries
BITBAKEPATH := "${@os.path.dirname(bb.utils.which(d.getVar('PATH'),'bitbake'))}"
PATH := "${@'${BITBAKEPATH}:' if '${BITBAKEPATH}' != '' else ''}${HOSTTOOLS_DIR}"

# # Only OE-Core should set/change this
# BB_GLOBAL_PYMODULES = "os sys time"

# where to find accessory files
LAYERDIR_isarpm = "${LAYERDIR}"

###

addpylib ${LAYERDIR}/lib oe

CONTAINER_ARCH ?= "unset"
CONTAINER_ARCH:x86-64 = "linux/amd64"
CONTAINER_ARCH:x86-64-v2 = "linux/amd64/v2"
CONTAINER_ARCH:aarch64 = "linux/aarch64"
```

## meta-almalinux/conf/layer.conf
```bitbake
# We have a conf and classes directory, add to BBPATH
BBPATH =. "${LAYERDIR}:"

# We have recipes-* directories, add to BBFILES
BBFILES += "${LAYERDIR}/recipes-*/*.bb \
            ${LAYERDIR}/recipes-*/*.bbappend"

BBFILE_COLLECTIONS += "almalinux"
BBFILE_PATTERN_almalinux = "^${LAYERDIR}/"
BBFILE_PRIORITY_almalinux = "5"

# FIXME can we add "alma10" to LAYERSERIES_CORENAMES?
LAYERSERIES_COMPAT_almalinux = "proto"

# This should only be incremented on significant changes that will
# cause compatibility issues with other layers
LAYERVERSION_almalinux = "1"

LAYERDEPENDS_almalinux = "isarpm"

###

HOSTTOOLS += " \
  git-lfs \
"
```

## meta-xcpng/conf/layer.conf
```bitbake
# We have a conf and classes directory, add to BBPATH
BBPATH =. "${LAYERDIR}:"

# We have recipes-* directories, add to BBFILES
BBFILES += "${LAYERDIR}/recipes-*/*.bb \
            ${LAYERDIR}/recipes-*/*.bbappend"

BBFILE_COLLECTIONS += "xcpng"
BBFILE_PATTERN_xcpng = "^${LAYERDIR}/"
BBFILE_PRIORITY_xcpng = "5"

LAYERSERIES_COMPAT_xcpng = "proto"

# This should only be incremented on significant changes that will
# cause compatibility issues with other layers
LAYERVERSION_xcpng = "1"

LAYERDEPENDS_xcpng = "isarpm"

###

HOSTTOOLS += " \
  git-lfs \
"
```
